## base_external/package/aesd-assignments/Config.in
```kconfig
config BR2_PACKAGE_AESD_ASSIGNMENTS
	bool "aesd-assignments"
	help
	  Installs writer, finder.sh, finder-test.sh, tester.sh and finder
	  configuration files in the target root filesystem.
	  Used to understand buildroot external trees and package builds.
```
